## conf/machine/beaglebone-white.conf
```bitbake
include conf/machine/beaglebone.conf

# Add original machine after this one
MACHINEOVERRIDES .= ":beaglebone"

PREFERRED_PROVIDER_virtual/kernel = "linux-dominion"
```
